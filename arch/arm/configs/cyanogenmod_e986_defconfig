## drivers/char/diag/Kconfig
```kconfig
menu "Diag Support"

config DIAG_CHAR
	tristate "char driver interface and diag forwarding to/from modem"
	default m
	depends on USB_G_ANDROID || USB_FUNCTION_DIAG || USB_QCOM_MAEMO
	depends on ARCH_MSM
	help
	 Char driver interface for diag user space and diag-forwarding to modem ARM and back.
	 This enables diagchar for maemo usb gadget or android usb gadget based on config selected.
endmenu

menu "DIAG traffic over USB"

config DIAG_OVER_USB
	bool "Enable DIAG traffic to go over USB"
        depends on ARCH_MSM
	default y
	help
	 This feature helps segregate code required for DIAG traffic to go over USB.
endmenu

menu "SDIO support for DIAG"

config DIAG_SDIO_PIPE
	depends on MSM_SDIO_AL
	default y
	bool "Enable 9K DIAG traffic over SDIO"
	help
	 SDIO Transport Layer for DIAG Router
endmenu

menu "HSIC support for DIAG"

config DIAG_BRIDGE_CODE
	depends on USB_QCOM_DIAG_BRIDGE
	default y
	bool "Enable QSC/9K DIAG traffic over SMUX/HSIC"
	help
	 SMUX/HSIC Transport Layer for DIAG Router
endmenu

menu "USB Only Diag Disable"
config LGE_USB_DIAG_DISABLE
	default n
	bool "Disable diag function"
	help
	 Provide method of diag enable or disable
endmenu

menu "USB Only MDM Diag Disable"

config LGE_USB_DIAG_DISABLE_ONLY_MDM
	default n
	bool "Disable Only MDM Diag function"
	help
	 Provide method of MDM diag enable or disable
endmenu

menu "LGE DM APP Support"

config LGE_DM_APP
	bool "LGE DM APP Support"
	default n
	depends on MACH_LGE
	help
	 LGE DM APP Support
endmenu
```

## drivers/net/wireless/bcmdhd/Kconfig
```kconfig
config BCMDHD
	tristate "Broadcom 4329/30 wireless cards support"
	depends on MMC
	---help---
	  This module adds support for wireless adapters based on
	  Broadcom 4329/30 chipset.

	  This driver uses the kernel's wireless extensions subsystem.

	  If you choose to build a module, it'll be called dhd. Say M if
	  unsure.

config BCM4339
	tristate "Broadcom 4339 wireless cards support"
	depends on BCMDHD
	---help---
	  This module adds support for wireless adapters based on
	  Broadcom 4339 chipset.

config BCMDHD_FW_PATH
	depends on BCMDHD
	string "Firmware path"
	default "/system/etc/firmware/fw_bcmdhd.bin"
	---help---
	  Path to the firmware file.

config BCMDHD_NVRAM_PATH
	depends on BCMDHD
	string "NVRAM path"
	default "/system/etc/wifi/bcmdhd.cal"
	---help---
	  Path to the calibration file.

config BCMDHD_WEXT
	bool "Enable WEXT support"
	depends on BCMDHD && CFG80211 = n
	select WIRELESS_EXT
	select WEXT_PRIV
	help
	  Enables WEXT support

config DHD_USE_STATIC_BUF
	bool "Enable memory preallocation"
	depends on BCMDHD
	default n
	---help---
	  Use memory preallocated in platform

config DHD_USE_SCHED_SCAN
	bool "Use CFG80211 sched scan"
	depends on BCMDHD && CFG80211
	default n
	---help---
	  Use CFG80211 sched scan

config BROADCOM_WIFI_RESERVED_MEM
       bool "BROADCOM Reserved memory for wifi device"
       depends on BCMDHD
       ---help---
         This is a configuration for broadcom WLAN driver.

config BCM4335BT
       bool "BROADCOM BTLOCK Enable"
       depends on BCM4335
       default y
       ---help---
         This is a configuration for bt lock enable.

config BCM4334
       tristate "Broadcom 4334 wireless cards support"
       depends on BCMDHD
       ---help---
         This module adds support for wireless adapters based on
         Broadcom 4334 chipset.

config LGE_BCM433X_PATCH
       bool "BCM433X Patch by LGE"
       default y

config BCMDHD_GPIO_WL_RESET
       depends on BCMDHD
       int "GPIO to the Reset"
       default 29
       ---help---
         GPIO to the Reset

config BCMDHD_HOSTWAKEUP_USE_GPIO
       depends on BCMDHD
       bool "Use GPIO to Host Wakeup"
       ---help---
         Use GPIO to Host Wakeup

config BCMDHD_HOSTWAKEUP_USE_SDIO
       depends on BCMDHD && BCMDHD_HOSTWAKEUP_USE_GPIO = n
       bool "Use SDIO pin to the Host Wakeup"
       ---help---
         Use SDIO pin to the Host Wakeup

config BCMDHD_GPIO_WL_HOSTWAKEUP
       depends on BCMDHD && BCMDHD_HOSTWAKEUP_USE_GPIO = y
       int "GPIO to the Host Wakeup"
       default 34
       ---help---
         GPIO to the Host Wakeup

config BCMDHD_HW_OOB
       depends on BCMDHD && BCMDHD_HOSTWAKEUP_USE_GPIO = y
       bool "Use H/W OOB to the Host Wakeup"
       default y
        ---help---
         Use H/W OOB to the Host Wakeup
```

## drivers/nfc/Kconfig
```kconfig
#
# Near Field Communication (NFC) devices
#

menuconfig NFC_DEVICES
	bool "Near Field Communication (NFC) devices"
	default n
	---help---
	  You'll have to say Y if your computer contains an NFC device that
	  you want to use under Linux.

	  You can say N here if you don't have any Near Field Communication
	  devices connected to your computer.

if NFC_DEVICES

config LGE_NFC
	bool "NFC Device Enabled for LGE"
	default n

config LGE_NFC_PN544_C2
	bool "PN544 C2 NFC driver"
	depends on I2C
	select CRC_CCITT
	default n
	---help---
	  Say yes if you want PN544 Near Field Communication driver.
	  This is for i2c connected version. If unsure, say N here.

	  To compile this driver as a module, choose m here. The module will
	  be called pn544.

config LGE_NFC_PN544_C3
	bool "PN544 C3 NFC driver"
	depends on I2C
	select CRC_CCITT
	default n
	---help---
	  Say yes if you want PN544 Near Field Communication driver.
	  This is for i2c connected version. If unsure, say N here.

	  To compile this driver as a module, choose m here. The module will
	  be called pn544.

config LGE_NFC_PRESTANDBY
	bool "NFC STANBY MODE"
	default n
	---help---
	  Say yes if you want to change a power state of pn544 to stanby mode in Kernel.
	  If unsure, say N here.

config LGE_NFC_MULTICORE_FASTBOOT
	bool "NFC MultiThread"
	default n
	---help---
	  Say yes if multi thread is applied for pre-standby.
	  If unsure, say N here.

config LGE_NFC_DEBUG_MESSAGE
	bool "NFC Debug Message"
	default n

config LGE_NFC_HW_QCT_APQ8064
	bool "Qualcom APQ8064 Chipset"
	default n

config LGE_NFC_HW_QCT_MSM8960
	bool "Qualcom APQ8960 Chipset"
	default n

config LGE_NFC_HW_QCT_MSM8930
	bool "Qualcom MSM8930 Chipset"
	default n

config LGE_NFC_HW_QCT_MSM8660
	bool "Qualcom MSM8660 Chipset"
	default n

config LGE_NFC_HW_QCT_MSM8255
	bool "Qualcom MSM8255 Chipset"
	default n

config LGE_NFC_HW_TI_OMAP4430
	bool "TI OMAP4430 Chipset"
	default n

config LGE_NFC_HW_NV_AP3X
	bool "Nvidia AP3X Chipset"
	default n

config LGE_NFC_SONY_CXD2235AGG
	bool "CXD2235AGG NFC driver"
	#depends on I2C && UART
	default n
	---help---
	  Say yes if you want CDX2235AGG Near Field Communication driver.
	  This is for i2c & UART connected version. If unsure, say N here.

	  To compile this driver as a module, choose m here. The module will
	  be called CDX2235AGG.

source "drivers/nfc/snfc/Kconfig"

endif # NFC_DEVICES
```

## drivers/nfc/snfc/Kconfig
```kconfig
##########################################################
#
#	Kconfig - NFC Driver (FOR CXD2235AGG)
#
##########################################################

config UART_CXD2235AGG
	tristate "CXD2235AGG NFC driver"
	#depends on UART
	#depends on I2C
	default n
	---help---
	  Say yes if you like to use CXD2235AGG through UART.
```

## drivers/video/mhl/Kconfig
```kconfig
#
# MHL drivers configuration
#

menuconfig MHL_SUPPORT
	bool "MHL device support"
	help
	  Enable this to be able to choose the drivers for controlling the
	  MHL function to connect to any MHL devices, for example to MHL monitor.

if MHL_SUPPORT

config SII8334_MHL_TX
	bool "MHL SiI8334 chip support"
	depends on FB_MSM_HDMI_COMMON
	default n
	---help---
	  Support for MHL sii8334 chip

config LG_MAGIC_MOTION_REMOCON
	bool "LG Magic motion remote controller support"
	depends on SII8334_MHL_TX
	default n
	---help---
	  Support for LG Magic motion controller

config LGE_MHL_REMOCON_TEST
	bool "LG Magic motion remote controller test"
	default n

endif
```
