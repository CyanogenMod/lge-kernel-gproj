## arch/arm/mach-msm/lge/Kconfig
```kconfig
config MACH_LGE
	bool

menu "LGE Board Selection"
source "arch/arm/mach-msm/lge/Kconfig.board"
endmenu


menu "LGE Specific Patches"

config LGE_HANDLE_PANIC
    tristate "Support LGE Kernel Panic Handler"
    default n
    depends on MACH_LGE
    help
      LGE Error Handler

config LGE_QFPROM_INTERFACE
	bool "Support qfprom interface"
	default n
	depends on MACH_LGE
	help
	  LGE QFPROM DRIVER.

config LGE_QC_LCDC_LUT
	bool "Set initial Qualcomm LCDC lut"
	default n
	depends on MACH_LGE
	help
	  Set initial Qualcomm LCDC Look Up Table.

config LGE_KCAL
	bool "Interface to calibrate LCD color temperature"
	default n
	depends on MACH_LGE
	help
	  Interface to calibrate LCD color temperature

config LGE_KCAL_QLUT
	bool "Interface to calibrate LCD color temperature by QLUT"
	default n
	depends on MACH_LGE && LGE_QC_LCDC_LUT && LGE_KCAL
	help
	  Interface to calibrate LCD color temperature by QLUT

config EARJACK_DEBUGGER
	bool "Earjack UART debugger support"
	depends on MACH_APQ8064_GKU || MACH_APQ8064_GKKT || MACH_APQ8064_GKSK || MACH_APQ8064_GVKT
	default n
	help
	  Saying Y here will support earjack type UART debugger cable

config LGE_BOOT_TIME_CHECK
	tristate "Support LGE BOOT TIME CHECK"
	default y
	depends on MACH_LGE
	help
	LGE SBL1 to LK BOOT TIME CHECKER.


#BEGIN: 0019632 chanha.park@lge.com 2012-05-31
#ADD: 0019632: [F200][BT] Bluetooth board bring-up	  
config LGE_BLUESLEEP
	default n
	bool "MSM8960 LGE Bluetooth LPM"
	depends on MACH_LGE
#END: 0019632 chanha.park@lge.com 2012-05-31

config LGE_ECO_MODE
    tristate "Support LGE ECO Mode"
    default n
    depends on MACH_LGE
    help
      LGE ECO mode support
config LGE_CRASH_HANDLER
	tristate "Support LGE Crash Handler"
	depends on !S390 && !UML && HAVE_MEMBLOCK
	select ANDROID_PERSISTENT_RAM
	default n
	help
	  LGE Crash Handler

config LGE_SUSPEND_TIME
    tristate "Log time spent in suspend"
    default y
    depends on MACH_LGE
	help
	  Prints the time spent in suspend in the kernel log, and
	  keeps statistics on the time spent in suspend in
	  /sys/kernel/debug/suspend_time

	  This patch serves same function with google's suspend_time.c

config LGE_EARLYSUSPEND_FUNC_TIME
    tristate "Log time spent in each earlysuspend call"
    default y
    depends on MACH_LGE
	help
	  Keeps the time statistics spent in each earlysuspend in 
	  /sys/kernel/debug/earlysuspend_func_time.
	  This file shows the average and max tiem of each 
	  earlysuspend/lateresume function.

config LGE_SUSPEND_AUTOTEST
    tristate "Test suspend/resume and earlysuspend/lateresume automatically"
    default y
    depends on MACH_LGE && SUSPEND && EARLYSUSPEND
	help
      This option will let you suspend your machine, and make it wake up
	  a few seconds later using an timer automatically.  
	  Enable this with a kernel parameter by sysfs.


config LGE_BITE_RESET
	tristate "Disable PS_HOLD reset"
	default n
	depends on MACH_LGE
	help
	  Reset device by WDT BITE instead of PS_HOLD

config LGE_R63311_COLOR_ENGINE
	bool "Interface to apply color engine"
	default y
	depends on MACH_LGE
	help
	  Interface to apply color engine

config LGIT_COLOR_ENGINE_SWITCH
	bool "Disable the color engine for camera"
	default y
	depends on MACH_LGE
	help
	  Enable the color engine on/off function for camera
config LGE_R63311_BACKLIGHT_CABC 
	bool "Interface to apply backlight cabc"
	default y
	depends on MACH_LGE
	help
	  Interface to apply backlight cabc

endmenu
```

## arch/arm/mach-msm/lge/Kconfig.board
```kconfig
#
# Inlcude the specific Kconfig file for LGE board
#

# J1V
source "arch/arm/mach-msm/lge/j1/Kconfig"

# GK
source "arch/arm/mach-msm/lge/gk/Kconfig"

# GV
source "arch/arm/mach-msm/lge/gv/Kconfig"

# GV KR
source "arch/arm/mach-msm/lge/gvkr/Kconfig"

config MACH_LGE_DUMMY
	bool "NONE (No device)"
```

## arch/arm/mach-msm/lge/L05E/Kconfig
```kconfig
config BOARD_HEADER_FILE
	string "LGE board specific header file name"
	default ""

config MACH_APQ8064_L05E
	depends on ARCH_APQ8064
	select MACH_LGE
		bool "MSM8960 L05E"
	help
	  Support for the LGE Fusion3 J1D(Docomo) device.

config LGE_USB_DIAG_DISABLE
	default n
	bool "Disable diag function"
	help
	 Provide method of diag enable or disable
```

## arch/arm/mach-msm/lge/gk/Kconfig
```kconfig
config BOARD_HEADER_FILE
	string "LGE board specific header file name"
	default ""

config MACH_APQ8064_GKU
	depends on ARCH_APQ8064
	select MACH_LGE
		bool "APQ064 GKU"
	help
	  Support for the LGE GK device.

config MACH_APQ8064_GKSK
	depends on ARCH_APQ8064
	select MACH_LGE
		bool "APQ8064 GKSK"
	help
	  Support for the LGE GK device.

config MACH_APQ8064_GKKT
	depends on ARCH_APQ8064
	select MACH_LGE
		bool "APQ8064 GKKT"
	help
	  Support for the LGE GK device.

config MACH_APQ8064_GK_KR
	depends on ARCH_APQ8064
	select MACH_LGE
		bool "APQ8064 GK SKT KT LGU"
	help
	  Support for the LGE GK device.

config MACH_APQ8064_GKATT
	depends on ARCH_APQ8064
	select MACH_LGE
		bool "APQ8064 GKATT"
	help
	  Support for the LGE GK device.

config MACH_APQ8064_GKOPENHK
	depends on ARCH_APQ8064
	select MACH_LGE
		bool "APQ8064 GKOPENHK"
	help
	  Support for the LGE GK device.

config MACH_APQ8064_GKOPENTW
	depends on ARCH_APQ8064
	select MACH_LGE
		bool "APQ8064 GKOPENTW"
	help
	  Support for the LGE GK device.

config MACH_APQ8064_GKSHBSG
	depends on ARCH_APQ8064
	select MACH_LGE
		bool "APQ8064 GKSHBSG"
	help
	  Support for the LGE GK device.

config MACH_APQ8064_GKOPENEU
	depends on ARCH_APQ8064
	select MACH_LGE
		bool "APQ8064 GKOPENEU"
	help
	  Support for the LGE GK device.

config MACH_APQ8064_GKOPENCIS
	depends on ARCH_APQ8064
	select MACH_LGE
		bool "APQ8064 GKOPENCIS"
	help
	  Support for the LGE GK device.

config MACH_APQ8064_GKTCLMX
	depends on ARCH_APQ8064
	select MACH_LGE
		bool "APQ8064 GKTCLMX"
	help
	  Support for the LGE GK device.

config MACH_APQ8064_GKOPENBR
	depends on ARCH_APQ8064
	select MACH_LGE
		bool "APQ8064 GKOPENBR"
	help
	  Support for the LGE GK device. 
	  
config MACH_APQ8064_GKVIVBR
	depends on ARCH_APQ8064
	select MACH_LGE
		bool "APQ8064 GKVIVBR"
	help
	  Support for the LGE GK device. 
	  
	  
config MACH_APQ8064_GKSTLSG
	depends on ARCH_APQ8064
	select MACH_LGE
		bool "APQ8064 GKSTLSG"
	help
	  Support for the LGE GK device. 
	  
config MACH_APQ8064_GKOPENSG
	depends on ARCH_APQ8064
	select MACH_LGE
		bool "APQ8064 GKOPENSG"
	help
	  Support for the LGE GK device. 
	  
config MACH_APQ8064_GKMONSG
	depends on ARCH_APQ8064
	select MACH_LGE
		bool "APQ8064 GKMONSG"
	help
	  Support for the LGE GK device. 	  
	  
config MACH_APQ8064_GKCHTTW
	depends on ARCH_APQ8064
	select MACH_LGE
		bool "APQ8064 GKCHTTW"
	help
	  Support for the LGE GK device.  

config MACH_APQ8064_GKOPENESA
	depends on ARCH_APQ8064
	select MACH_LGE
		bool "APQ8064 GKOPENESA"
	help
	  Support for the LGE GK device. 

config MACH_APQ8064_GKOPENAME
	depends on ARCH_APQ8064
	select MACH_LGE
		bool "APQ8064 GKOPENAME"
	help
	  Support for the LGE GK device.	

config MACH_APQ8064_GKOPENIL
	depends on ARCH_APQ8064
	select MACH_LGE
		bool "APQ8064 GKOPENIL"
	help
	  Support for the LGE GK device.	  

config MACH_APQ8064_GKOPENMY
	depends on ARCH_APQ8064
	select MACH_LGE
		bool "APQ8064 GKOPENMY"
	help
	  Support for the LGE GK device.

config MACH_APQ8064_GKOPENTH
	depends on ARCH_APQ8064
	select MACH_LGE
		bool "APQ8064 GKOPENTH"
	help
	  Support for the LGE GK device.

config MACH_APQ8064_GKOPENZA
	depends on ARCH_APQ8064
	select MACH_LGE
		bool "APQ8064 GKOPENZA"
	help
	  Support for the LGE GK device. 

config MACH_APQ8064_GKOPENID
	depends on ARCH_APQ8064
	select MACH_LGE
		bool "APQ8064 GKOPENID"
	help
	  Support for the LGE GK device.

config MACH_APQ8064_GKORIIL
	depends on ARCH_APQ8064
	select MACH_LGE
		bool "APQ8064 GKORIIL"
	help
	  Support for the LGE GK device.

config MACH_APQ8064_GKCCMIL
	depends on ARCH_APQ8064
	select MACH_LGE
		bool "APQ8064 GKCCMIL"
	help
	  Support for the LGE GK device.

config MACH_APQ8064_GKMIRIL
	depends on ARCH_APQ8064
	select MACH_LGE
		bool "APQ8064 GKMIRIL"
	help
	  Support for the LGE GK device.

config MACH_APQ8064_GKPCLIL
	depends on ARCH_APQ8064
	select MACH_LGE
		bool "APQ8064 GKPCLIL"
	help
	  Support for the LGE GK device.

config MACH_APQ8064_GKGLOBAL
	bool "LGE GK Global device"
	depends on ARCH_APQ8064 && ( MACH_APQ8064_GKCHTTW || MACH_APQ8064_GKOPENAME || MACH_APQ8064_GKOPENBR || MACH_APQ8064_GKVIVBR || MACH_APQ8064_GKOPENESA || MACH_APQ8064_GKOPENEU || MACH_APQ8064_GKOPENHK || MACH_APQ8064_GKOPENIL || MACH_APQ8064_GKOPENSG || MACH_APQ8064_GKMONSG || MACH_APQ8064_GKOPENTW || MACH_APQ8064_GKSHBSG || MACH_APQ8064_GKSTLSG || MACH_APQ8064_GKTCLMX || MACH_APQ8064_GKOPENMY || MACH_APQ8064_GKOPENZA || MACH_APQ8064_GKOPENID || MACH_APQ8064_GKOPENTH || MACH_APQ8064_GKCCMIL || MACH_APQ8064_GKMIRIL || MACH_APQ8064_GKORIIL || MACH_APQ8064_GKPCLIL || MACH_APQ8064_GKOPENCIS )
	help
	  Support for the LGE GK Global device.	  
```

## arch/arm/mach-msm/lge/gv/Kconfig
```kconfig
config BOARD_HEADER_FILE
	string "LGE board specific header file name"
	default ""

config MACH_APQ8064_GVDCM
	depends on ARCH_APQ8064
	select MACH_LGE
		bool "APQ8064 GVDCM"
	help
	  Support for the LGE GV device.

config MACH_APQ8064_GVKDDI
	depends on ARCH_APQ8064
	select MACH_LGE
		bool "APQ8064 GVKDDI"
	help
	  Support for the LGE GV device.
```

## arch/arm/mach-msm/lge/gvkr/Kconfig
```kconfig
config BOARD_HEADER_FILE
	string "LGE board specific header file name"
	default ""

config MACH_APQ8064_GVKT
	depends on ARCH_APQ8064
	select MACH_LGE
		bool "APQ8064 GVKT"
	help
	  Support for the LGE GV device.

config MACH_APQ8064_GV_KR
	depends on ARCH_APQ8064
	select MACH_LGE
		bool "APQ8064 GV KR"
	help
	  Support for the LGE GVK device.
```

## arch/arm/mach-msm/lge/j1/Kconfig
```kconfig
config BOARD_HEADER_FILE
	string "LGE board specific header file name"
	default ""

config MACH_APQ8064_J1V
	depends on ARCH_APQ8064
	select MACH_LGE
		bool "APQ8064 J1V"
	help
	  Support for the LGE Fusion3 J1V device.

config MACH_APQ8064_J1U
	depends on ARCH_APQ8064
	select MACH_LGE
		bool "APQ8064 J1U"
	help
	  Support for the LGE Fusion3 J1U(U+) device.

config MACH_APQ8064_J1A
	depends on ARCH_APQ8064
	select MACH_LGE
		bool "APQ8064 J1A"
	help
	  Support for the LGE Fusion3 J1A(AT&T) device.

config MACH_APQ8064_J1SP
	depends on ARCH_APQ8064
	select MACH_LGE
		bool "APQ8064 J1SP"
	help
	  Support for the LGE Fusion3 J1SP(Sprint) device.

config MACH_APQ8064_J1D
	depends on ARCH_APQ8064
	select MACH_LGE
		bool "APQ8064 J1D"
	help
	  Support for the LGE Fusion3 J1D(Docomo) device.

config MACH_APQ8064_J1SK
	depends on ARCH_APQ8064
	select MACH_LGE
		bool "APQ8064 J1SK"
	help
	  Support for the LGE Fusion3 J1SK(SKT) device.

config MACH_APQ8064_J1KT
	depends on ARCH_APQ8064
	select MACH_LGE
		bool "APQ8064 J1KT"
	help
	  Support for the LGE Fusion3 J1KT(KT) device.

config MACH_APQ8064_J1KD
	depends on ARCH_APQ8064
	select MACH_LGE
		bool "APQ8064 J1KD"
	help
	  Support for the LGE Fusion3 J1D(KDDI) device.
config MACH_APQ8064_J1R
	depends on ARCH_APQ8064
	select MACH_LGE
		bool "APQ8064 J1R"
	help
	  Support for the LGE Fusion3 J1R(ROGERS) device.
config MACH_APQ8064_J1B
	depends on ARCH_APQ8064
	select MACH_LGE
		bool "APQ8064 J1B"
	help
	  Support for the LGE Fusion3 J1B(BELL) device.
config MACH_APQ8064_J1TL
	depends on ARCH_APQ8064
	select MACH_LGE
		bool "APQ8064 J1TL"
	help
	  Support for the LGE Fusion3 J1TL(TELUS) device.
config MACH_APQ8064_J1TM
	depends on ARCH_APQ8064
	select MACH_LGE
		bool "APQ8064 J1TM"
	help
	  Support for the LGE Fusion3 J1TM(TMUS) device.
config MACH_APQ8064_J1VD
	depends on ARCH_APQ8064
	select MACH_LGE
		bool "APQ8064 J1VD"
	help
	  Support for the LGE Fusion3 J1VD(VDF) device.
config MACH_APQ8064_J1X
	depends on ARCH_APQ8064
	select MACH_LGE
		bool "APQ8064 J1X"
	help
	  Support for the LGE Fusion3 J1X(VDF) device.

config LGE_USB_DIAG_DISABLE
	default n
	bool "Disable diag function"
	help
	 Provide method of diag enable or disable
```

## drivers/broadcast/Kconfig
```kconfig
# LGE Broadcast Device Driver Support

menu "LGE Broadcast Device Support"


config LGE_BROADCAST_ONESEG
	bool "OneSeg Broadcast service"
	depends on MACH_APQ8064_J1KD || MACH_APQ8064_J1D || MACH_APQ8064_GVDCM || MACH_APQ8064_GVKDDI
	default y
	help
	  Select this if you want to use Japanese 1Seg mobile broadcast service


config LGE_BROADCAST_TDMB
	bool "LGE broadcast TDMB device Driver"
	depends on MACH_APQ8064_J1U || MACH_APQ8064_J1KT || MACH_APQ8064_J1SK || MACH_APQ8064_GKU || MACH_APQ8064_GKKT || MACH_APQ8064_GKSK
	default y
	help
	  Select this if you want to use TDMB broadcast service
	  
source "drivers/broadcast/oneseg/Kconfig"
source "drivers/broadcast/tdmb/Kconfig"
endmenu
```

## drivers/broadcast/oneseg/Kconfig
```kconfig
#
# Broadcast Device Driver Support
#

menu "LGE Japanese Mobile Broadcast(ISDB-T 1seg/ISDB-Tmm 13seg) Device Support"

config LGE_BROADCAST_ONESEG_MB86A35S
	bool "1Seg broacast tuner chipset mb86a35s  device driver"
	depends on LGE_BROADCAST_ONESEG && MACH_APQ8064_J1D
	default y
	help
	  Select this if you want to use Japanese 1Seg mobile broadcast service
	  
config LGE_BROADCAST_ONESEG_FC8150
	bool "1Seg broacast tuner chipset fc8150  device driver"
	depends on LGE_BROADCAST_ONESEG && MACH_APQ8064_J1KD
	default y
	help
	  Select this if you want to use Japanese 1Seg mobile broadcast service

config LGE_BROADCAST_ONESEG_TCC3530
	bool "1Seg broacast tuner chipset tcc3530  device driver"
#	depends on LGE_BROADCAST_ONESEG && MACH_APQ8064_J1D
	depends on LGE_BROADCAST_ONESEG && MACH_APQ8064_GVDCM
	default y
	help
	  Select this if you want to use Japanese 1Seg mobile broadcast service
	  
endmenu
```

## drivers/broadcast/tdmb/Kconfig
```kconfig
#menu "BROADCAST_DEVICE"

#
# Broadcast Device Driver Support
#

#menu "BROADCAST_DEVICE"

config LGE_BROADCAST_TDMB_FC8050
	bool "LGE broacast TDMB FC8050 device"
	depends on LGE_BROADCAST_TDMB && (MACH_APQ8064_J1U || MACH_APQ8064_J1KT || MACH_APQ8064_J1SK || MACH_APQ8064_GKU || MACH_APQ8064_GKKT || MACH_APQ8064_GKSK)
	default y
	help
	  Select this if you want to use broadcast service
	  
#config LGE_BROADCAST_TDMB_LG2102
#	bool "LGE broacast TDMB LG2102 device"
#	depends on LGE_BROADCAST_TDMB
#	default n
#	help
#	  Select this if you want to use broadcast service
	  
#config LGE_BROADCAST_TDMB_T3900
#	bool "LGE broacast TDMB T3900 device"
#	depends on LGE_BROADCAST_TDMB
#	default y
#	help
#	  Select this if you want to use broadcast service	  	  
#endmenu
```
